## lib/liblua/Kconfig
```kconfig
config LIB_LUA
  bool "Lua"
  help
     The lua programming language compiler and interpreter.
     See http://www.lua.org/

config LIB_LUA_SHELL
	bool "Lua shell"
	depends on LIB_LUA

config LIB_LUA_LUAFILESYSTEM
  bool "Lua filesystem"
  depends on LIB_LUA
  help
    LuaFileSystem is a Lua library developed to complement the set of
    functions related to file systems offered by the standard Lua distribution.
    LuaFileSystem offers a portable way to access the underlying
    directory structure and file attributes.

config LIB_LUA_LUASOCKET
  bool "Lua socket"
  depends on LIB_LUA
  help
    LuaSocket is a Lua extension library that is composed by two parts:
    a C core that provides support for the TCP and UDP transport layers,
    and a set of Lua modules that add support for functionality commonly
    needed by applications that deal with the Internet.

config LIB_LUA_LUAXAVANTE
  bool "Lua xavante"
  depends on LIB_LUA_LUASOCKET
  help
    Xavante is a Lua HTTP 1.1 Web server that uses a modular architecture based on URI mapped handlers.

config LIB_LUA_JSON
  bool "Lua JSON"
  depends on LIB_LUA
  help
    JSON4Lua implements JSON (JavaScript Object Notation) encoding and decoding.

config LIB_LUA_SQLITE
	bool "Lua SQLite library"
	depends on LIB_LUA
	help
	  lsqlite3 is a thin wrapper around the public domain SQLite3 database engine.

config LIB_LUA_UCI
	bool "Lua UCI library"
	depends on LIB_UCI && LIB_LUA

config LIB_LUA_BITSTRING
	bool "Lua bitstring library"
	depends on LIB_LUA

config LIB_LUA_LSYSLOG
	bool "Lua wrapper for the syslog C API"
	depends on LIB_LUA

config LIB_LUA_LSIGNALS
	bool "Lua wrapper for signals API"
	depends on LIB_LUA

config LIB_LUA_LWATCHDOG
	bool "Lua interface for /dev/watchdog"
	depends on LIB_LUA

config LIB_LUA_LAIO
	bool "Lua wrapper for AIO API"
	depends on LIB_LUA
```

## lib/libtomcrypt/Kconfig
```kconfig
config LIB_TOMCRYPT
	bool "Build libtomcrypt"
	default n
	help
	  LibTomCrypt is a fairly comprehensive, modular and portable cryptographic
	  toolkit that provides developers with a vast array of well known
	  published block ciphers, one-way hash functions, chaining modes,
	  pseudo-random number generators, public key cryptography and a plethora
	  of other routines.

config LIB_TOMCRYPT_CIPHER_BLOWFISH
	bool "BlowFish cipher"
	depends on LIB_TOMCRYPT

config LIB_TOMCRYPT_CIPHER_DES
	bool "DES/3DES ciphers"
	depends on LIB_TOMCRYPT

config LIB_TOMCRYPT_CIPHER_AES128
	bool "AES128 cipher"
	depends on LIB_TOMCRYPT

config LIB_TOMCRYPT_MODE_CBC
	bool "Mode CBC"
	depends on LIB_TOMCRYPT

config LIB_TOMCRYPT_HASH_MD5
	bool "MD5 hash"
	depends on LIB_TOMCRYPT

config LIB_TOMCRYPT_HASH_SHA1
	bool "SHA1 hash"
	depends on LIB_TOMCRYPT

config LIB_TOMCRYPT_PRNG_SYSTEM
	bool "PRNG system"
	depends on LIB_TOMCRYPT

config LIB_TOMCRYPT_PRNG_DEVRANDOM
	bool "PRNG /dev/random"
	depends on LIB_TOMCRYPT

config LIB_TOMCRYPT_URANDOM_FIRST
	bool "Try to use /dev/urandom first"
	depends on LIB_TOMCRYPT_PRNG_DEVRANDOM

config LIB_TOMCRYPT_PK_RSA
	bool "RSA"
	depends on LIB_TOMCRYPT

config LIB_TOMCRYPT_PK_DSA
	bool "DSA"
	depends on LIB_TOMCRYPT

config LIB_TOMCRYPT_PK_ECC
	bool "Elliptic Curve Criptography"
	depends on LIB_TOMCRYPT

config LIB_TOMCRYPT_ECC_CURVE_SECP160R1
	bool "Use curve SECP160R1"
	depends on LIB_TOMCRYPT_PK_ECC
```

## lib/libtommath/Kconfig
```kconfig
config LIB_TOMMATH
	bool "TomMath"
	default n

config LIB_TOMMATH_FASTMATH
	bool "TomsFastMath"
	default n
	depends on LIB_TOMMATH
	help
	  TomsFastMath is a fast public domain, open source, large integer
	  arithmetic library written in portable ISO C. It is a port of
	  LibTomMath with optional support for inline assembler multipliers.
	  It has the following features.

config LIB_TOMMATH_MATH
	bool "LibTomMath"
	default n
	depends on LIB_TOMMATH
	help
	  LibTomMath is a free open source portable number theoretic
	  multiple-precision integer library written entirely in C. (phew!).
	  The library is designed to provide a simple to work with API that
	  provides fairly efficient routines that build out of the box without
	  configuration.
```
